// Copyright (C) 2016 i-Chips Technology Inc. All Rights Reserved.
#include "headers.h"

#include <string.h>
#include <stdio.h>
//#include <conio.h>
#include <stdlib.h>
#include <math.h>
#include <float.h>
#include <stdint.h>
#include "arm_math.h"
//#include "stm32f4xx_conf.h"


#include "declare_gDef.h"
#include "declare_gPM.h"
#include "declare_gPS.h"
#include "declare_gPI.h"
#include "declare_gVar.h"
#include "declare_gFunc.h"
#include "individual_param.h"
#include "c381.h"

#if 0
static const short LUT[10][24]={
		0x02 ,  0x03 ,  0x04 ,  0x04 ,  0x05 ,  0x06 ,  0x07 ,  0x08 ,  0x09 ,  0x09 ,  0x0a ,  0x0b ,  0x0c ,  0x0c ,  0x0d ,  0x0e ,  0x0e ,  0x0f ,  0x0f ,  0x11 ,  0x12 ,  0x13 ,  0x13 ,  0x14,
		0xfe ,  0xff ,  0xff ,  0x00 ,  0x01 ,  0x02 ,  0x03 ,  0x05 ,  0x06 ,  0x08 ,  0x09 ,  0x0b ,  0x0c ,  0x0e ,  0x0f ,  0x10 ,  0x12 ,  0x13 ,  0x14 ,  0x15 ,  0x17 ,  0x16 ,  0x18 ,  0x16,
		0xfa ,  0xfa ,  0xfa ,  0xfb ,  0xfc ,  0xfd ,  0xff ,  0x00 ,  0x02 ,  0x04 ,  0x06 ,  0x09 ,  0x0c ,  0x0e ,  0x11 ,  0x11 ,  0x16 ,  0x18 ,  0x1a ,  0x1c ,  0x1e ,  0x1f ,  0x1e ,  0x1e,
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		0x00 ,  0x00 ,  0x00 ,  0x00 ,  0x00 ,  0x00 ,  0x00 ,  0x00 ,  0x00 ,  0xff ,  0xfe ,  0xfd ,  0xfc ,  0xfc ,  0xfd ,  0x00 ,  0x05 ,  0x0d ,  0x18 ,  0x23 ,  0x2e ,  0x38 ,  0x3e ,  0x40
};
#endif

void SetLut(void)
{
#if 0//HPC add
	int16_t i, j;
	float scl;
	float scl_min = 1;

	// hlut
	for(j = 0; j < 9; j++) {
		for(i = 0; i < 8; i++) {
			scl = (PM_GRID[i+1][j].x - PM_GRID[i][j].x) / (float)(PS_CUR_DEF_IX[i+1] - PS_CUR_DEF_IX[i]);
			scl_min = (scl < scl_min)  ? scl : scl_min;

		}
	}

	// vlut
	for(j = 0; j < 9; j++) {
		for(i = 0; i < 8; i++) {
			scl = (PM_GRID[j][i+1].y - PM_GRID[j][i].y) / (float)(PS_CUR_DEF_IY[i+1] - PS_CUR_DEF_IY[i]);
			scl_min = (scl < scl_min)  ? scl : scl_min;
		}
	}

	scl_min = (scl_min >= 1) ? 9:((scl_min > 0.96f) ? 8: ((scl_min > 0.93f) ? 7: ((scl_min < 0.3f) ? 0: scl_min * 10 - 3)));

	// +++++ set LUT registers +++++ //
	for(i = 0; i < 24; i++) {
		C381_Write_Bank_Reg(15,(B15_HLUT0+(i)), LUT[((int16_t)scl_min)][i]&0xff);	// HLUT0-23 ((int16_t)scl_min-1)
	}
	for(i = 0; i < 24; i++) {
		C381_Write_Bank_Reg(15, (B15_VLUT0+(i)), LUT[((int16_t)scl_min)][i]&0xff);	// VLUT0-23 ((int16_t)scl_min-1)
	}
#endif//HPC add
	return;
}
